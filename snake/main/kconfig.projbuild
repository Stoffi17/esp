## snake/main/kconfig.projbuild
```kconfig
menu "Snake Configuration"

    config BTN1_GPIO
        int "Left Button GPIO"
        default 9
        help
            GPIO number for the left Button.

    config BTN2_GPIO
        int "Right Button GPIO"
        default 2
        help
            GPIO number for the right Button and Potentiometer.

    config LED_STRIP_GPIO
        int "LED Strip GPIO number"
        default 8
        help
            GPIO number used to control the addressable LED strip. Make sure this matches your hardware setup.

    config LED_COUNT
        int "Number of LEDs in the strip"
        default 25
        help
            Define the number of LEDs in the addressable LED strip.

    choice LED_STRIP_BACKEND
        prompt "LED Strip Backend Peripheral"
        default LED_STRIP_BACKEND_RMT if SOC_RMT_SUPPORTED
        default LED_STRIP_BACKEND_SPI
        help
            Select the backend peripheral to drive the LED strip. Choose RMT if supported by your ESP32 chip, otherwise SPI.

        config LED_STRIP_BACKEND_RMT
            depends on SOC_RMT_SUPPORTED
            bool "RMT"
            help
                Use the RMT peripheral to drive the LED strip. This is a common method for driving addressable LEDs.

        config LED_STRIP_BACKEND_SPI
            bool "SPI"
            help
                Use the SPI peripheral to drive the LED strip. Suitable for specific LED types that support SPI communication.

    endchoice

    config BLINK_PERIOD
        int "Blink period in ms"
        range 10 3600000
        default 1000
        help
            Define the blinking period in milliseconds.

endmenu
```

## softAP/main/Kconfig.projbuild
```kconfig
menu "Example Configuration"

    config ESP_WIFI_SSID
        string "WiFi SSID"
        default "ESP Wlan"
        help
            SSID (network name) for the example to connect to.

    config ESP_WIFI_PASSWORD
        string "WiFi Password"
        default "pass1234"
        help
            WiFi password (WPA or WPA2) for the example to use.
    config ESP_WIFI_CHANNEL
        int "WiFi Channel"
        range 1 13
        default 1
        help
            WiFi channel (network channel) for the example to use.

    config ESP_MAX_STA_CONN
        int "Maximal STA connections"
        default 4
        help
            Max number of the STA connects to AP.

    orsource "$IDF_PATH/examples/common_components/env_caps/$IDF_TARGET/Kconfig.env_caps"

    choice BLINK_LED
        prompt "Blink LED type"
        default BLINK_LED_STRIP
        help
            Select the LED type. A normal level controlled LED or an addressable LED strip.
            The default selection is based on the Espressif DevKit boards.
            You can change the default selection according to your board.

        config BLINK_LED_GPIO
            bool "GPIO"
        config BLINK_LED_STRIP
            bool "LED strip"
    endchoice

    choice BLINK_LED_STRIP_BACKEND
        depends on BLINK_LED_STRIP
        prompt "LED strip backend peripheral"
        default BLINK_LED_STRIP_BACKEND_RMT if SOC_RMT_SUPPORTED
        default BLINK_LED_STRIP_BACKEND_SPI
        help
            Select the backend peripheral to drive the LED strip.

        config BLINK_LED_STRIP_BACKEND_RMT
            depends on SOC_RMT_SUPPORTED
            bool "RMT"
        config BLINK_LED_STRIP_BACKEND_SPI
            bool "SPI"
    endchoice

    config BLINK_GPIO
        int "Blink GPIO number"
        range ENV_GPIO_RANGE_MIN ENV_GPIO_OUT_RANGE_MAX
        default 8
        help
            GPIO number (IOxx) to blink on and off the LED.
            Some GPIOs are used for other purposes (flash connections, etc.) and cannot be used to blink.

        config LED_AMOUNT
            int "LED Amount"
            default 25
            help
                Amount of LEDs on LED Strip.

    config BLINK_PERIOD
        int "Blink period in ms"
        range 10 3600000
        default 1000
        help
            Define the blinking period in milliseconds.

    config BUTTON1_GPIO
        int "Button GPIO"
        default 9
        help
            GPIO the left Button is connected to.

    config BUTTON2_GPIO
        int "Button GPIO"
        default 2
        help
            GPIO the right Button is connected to.
endmenu
```
